## conf/layer.conf
```bitbake
# We have a conf and classes directory, add to BBPATH
BBPATH .= ":${LAYERDIR}"

# We have recipes-* directories, add to BBFILES
BBFILES += "${LAYERDIR}/recipes-*/*/*.bb \
            ${LAYERDIR}/recipes-*/*/*.bbappend"

BBFILE_COLLECTIONS += "meta-kde-gear"
BBFILE_PATTERN_meta-kde-gear = "^${LAYERDIR}/"
BBFILE_PRIORITY_meta-kde-gear = "8"

LAYERDEPENDS_meta-kde-gear = "core"
LAYERSERIES_COMPAT_meta-kde-gear = "kirkstone"

LICENSE_PATH += "${LAYERDIR}/files/common-licenses"
```
